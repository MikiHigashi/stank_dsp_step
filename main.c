// 自作ステッピングモータードライバー dsPIC 版
#define FCY 69784687UL
#include <libpic30.h>
#include "mcc_generated_files/mcc.h"
#include <stdio.h>
#include <string.h>
#include "soft_i2c.h"
#include "lcd_i2c.h"
#include "ltc2630.h"


uint16_t left = 0x8080; // SPI2DMAにて旋回値を受け取る


uint16_t table_pwm[] = {
	0,
	65535,
	59577,
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	1075,
	1068
};


uint8_t table_ps[] = {
	0,
	6,
	6,
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	0,
	0
};


uint8_t table_m0[] = {
	0,
	1,
	1,
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	1,
	1
};


uint8_t table_m1[] = {
	0,
	1,
	1,
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	1,
	1
};


uint8_t table_m2[] = {
	0,
	1,
	1,
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	0,
	0
};


uint8_t table_idx[] = {
    0,
	1,
	2,
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	229,
	229
};


uint8_t table_idx2[] = {
	0,
	50,
	52,
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	229,
};



// 超低速と低速の境界
#define MIN_SPEED 50
// delay_ms
#define NUM_WAIT 3


char buf[32];
uint8_t motor = 128; // 走行値

uint16_t pulse_snd;
uint16_t pulse_res;
//uint16_t pulse_mol = 0; // MO がＬ期間に何回のセンサーパルスが入ったか
//uint16_t pulse_mo1 = 0; // MO の１周期間に何回のセンサーパルスが入ったか
//uint16_t pulse_mo = 0; // MO の新規発生


uint8_t PS_M1 = 0;

uint8_t now_speed = 0; // 現在速度
uint8_t pre_speed = 0; // 前回速度
signed char now_cw_n_ccw = 0; // 現在回転方向 1:正 -1:逆 -:停止

uint8_t target_speed = 0; // 目標速度
signed char target_cw_n_ccw = 0; // 目標回転方向 1:正 -1:逆 -:停止


//uint16_t lata0; // 旧LATA
//uint16_t lata1; // 最新LATA
//uint16_t latax; // 変化


void set_speed(uint8_t spd) {
        uint16_t s = table_pwm[spd];
        PTCON2 = table_ps[spd]; // プリスケーラー
        PTPER = s;
        PDC1 = (s >> 1);                
        _LATB2 = table_m0[spd]; // MODE0 ピン出力
        _LATB3 = table_m1[spd]; // MODE1 ピン出力
        _LATB4 = table_m2[spd]; // MODE2 ピン出力
}


uint8_t flg_late1;
uint8_t flg_latel;


// アラート発生
void in_alert(void) {
    PDC1 = 0;                
    PWM_Disable();
    ENABLE_SetLow();
    __delay_ms(10);
    ENABLE_SetHigh();
    PWM_Enable();
}


int main(void)
{
    // initialize the device
    SYSTEM_Initialize();
    DMA_ChannelEnable(DMA_CHANNEL_0);
    DMA_PeripheralAddressSet(DMA_CHANNEL_0, (volatile unsigned int) &SPI2BUF);
    DMA_StartAddressASet(DMA_CHANNEL_0, (uint16_t)(&left));        
    
//    char buf[32];
//    __delay_ms(100);    
//    LCD_i2c_init(8);

    // 出力全OFF
    MODE0_SetHigh(); // 1/128step
    MODE1_SetHigh(); // 1/128step
    MODE2_SetHigh(); // 1/128step
    PTPER = 65535;
    PDC1 = 0;                
    PWM_Disable();
    ENABLE_SetHigh();
    flg_late1 = flg_latel = 0;

    motor = 0;
    now_speed = pre_speed = 0;
    now_cw_n_ccw = 0;
    LTC2630_write(0);
    
    WATCHDOG_TimerClear();
    __delay_ms(500);

    while (1)
    {
        WATCHDOG_TimerClear();

        if ((LO0_GetValue() == 0) || (LO1_GetValue() == 0)) {
            in_alert();
        }

        // 入力値
        uint8_t turn = (left & 255); // 旋回値
        motor = (left >> 8); // 走行値
        
        if ((motor <=  136) && (motor >= 120)) {
            motor = 0; // ほぼ停止なので照準用超信地旋回する
        }
        else {
            motor = 1; // 走行中なので走行用旋回する
        }
        
        if (turn > 128) {
            if (motor) {
                target_speed = table_idx2[turn - 128]; // 目標速度
            }
            else {
                target_speed = table_idx[turn - 128]; // 目標速度
            }
            target_cw_n_ccw = 1;
        }
        else if (turn < 128) {
            if (motor) {
                target_speed = table_idx2[128 - turn]; // 目標速度
            }
            else {
                target_speed = table_idx[128 - turn]; // 目標速度
            }
            target_cw_n_ccw = (-1);
        }
        else {
            target_speed = 0; // 目標速度
            target_cw_n_ccw = 0;
        }

//        LCD_i2C_cmd(0x80);
//        sprintf(buf, "%3d %3d" , target_speed, motor);
//        LCD_i2C_data(buf);
        
        if (target_cw_n_ccw == now_cw_n_ccw) {
            if (target_speed <= MIN_SPEED) { // あるていど遅い
                now_speed = target_speed; // 即座に目標速度に合わせる
            }
            else {
                if (now_speed < target_speed) {
                    if (target_speed > MIN_SPEED) {
                        if (now_speed < MIN_SPEED) {
                            now_speed = MIN_SPEED;
                        }
                        else {
                            now_speed ++;
                        }
                    }
                    else {
                        now_speed = target_speed;
                    }
                }
                if (now_speed > target_speed) {
                    now_speed --;
                }
            }
        }
        else { // 向きが違う
            if (now_cw_n_ccw) { // 停止ではない
                // いったん停止させる
                now_cw_n_ccw = 0;
                now_speed = 0;
            }
            else {
                now_cw_n_ccw = target_cw_n_ccw;
                if (now_cw_n_ccw > 0) {
                    CW_CCW_SetLow();
                }
                else {
                    CW_CCW_SetHigh();
                }
            }
        }

        if (now_speed > 0) {
            if (now_speed != pre_speed) {
                set_speed(now_speed);
                if (now_speed < MIN_SPEED) {
                    LTC2630_write(500);
                }
                else {
                    LTC2630_write(1700);
                }
                PWM_Enable();
            }
        }
        else {
            PDC1 = 0;                
            PWM_Disable();
        }
        
        __delay_ms(NUM_WAIT);
        pre_speed = now_speed;
    }
    return 1; 
}
/**
 End of File
*/

